## CMakeLists.txt
```
# Copyright 2021-2022 Arm Limited and/or its affiliates <open-source-office@arm.com>
#
# SPDX-License-Identifier: Apache-2.0

cmake_minimum_required(VERSION 3.20.0)
find_package(Zephyr REQUIRED HINTS $ENV{ZEPHYR_BASE})
set(APP_DEVICE_DIR src/Device)
set(APP_MODEL_DIR src/Model)
set(APP_SRC_DIR src/)
set(APP_NPU_DIR src/NPU)
set(APP_PROFILER_DIR src/ProfilerCounter)
set(APP_THIRDPARTY_MLEVK_DIR ../../ThirdParty/ml-embedded-evaluation-kit)
set(APP_THIRDPARTY_OMV ../../ThirdParty/openmv)

project(NN_ImgClasslInference)

target_include_directories(app PRIVATE
    ${APP_DEVICE_DIR}/include
)

target_include_directories(app PRIVATE
    ${APP_PROFILER_DIR}/include
)

target_include_directories(app PRIVATE
    ${APP_NPU_DIR}/include
)

target_include_directories(app PRIVATE
    ${APP_MODEL_DIR}/include
)

target_include_directories(app PRIVATE
    ${APP_THIRDPARTY_MLEVK_DIR}/source/application/api/common/include
    ${APP_THIRDPARTY_MLEVK_DIR}/source/log/include
    ${APP_THIRDPARTY_MLEVK_DIR}/source/profiler/include
    ${APP_THIRDPARTY_MLEVK_DIR}/source/math/include
)

target_include_directories(app PRIVATE
    ${APP_THIRDPARTY_OMV}/omv/imlib
    ${APP_THIRDPARTY_OMV}/omv/alloc
    ${APP_THIRDPARTY_OMV}/omv/common
    ${APP_THIRDPARTY_OMV}/omv/Lib
)

target_compile_definitions(app PRIVATE
    FS_FATFS_WINDOW_ALIGNMENT=32
    NVT_DCACHE_ON=1
    ARM_NPU
)

if(CONFIG_APP_OD_PROFILE_ENABLED)
    target_compile_definitions(app PRIVATE __PROFILE__)
endif()

if(CONFIG_APP_OD_UVC_SHOW_IMAGE)
    target_compile_definitions(app PRIVATE __USE_UVC__)
endif()

if(CONFIG_APP_OD_LCD_SHOW_IMAGE)
    target_compile_definitions(app PRIVATE __USE_DISPLAY__)
endif()

if(CONFIG_LT7381_MPU_PANEL)
    target_compile_definitions(app PRIVATE __LCD_LT7381_PANEL__)
endif()

if(CONFIG_FSA506_MPU_PANEL)
    target_compile_definitions(app PRIVATE __LCD_FSA506_PANEL__)
endif()

if(CONFIG_ILI9341_SPI_PANEL)
    target_compile_definitions(app PRIVATE __LCD_ILI9341_PANEL__)
endif()

if((CONFIG_APP_OD_LCD_SHOW_IMAGE) OR (CONFIG_APP_OD_UVC_SHOW_IMAGE))
    target_compile_definitions(app PRIVATE __PREVIEW_SUPPORT__)
endif()

if(CONFIG_CMOS_HM1055_SENSOR)
    target_compile_definitions(app PRIVATE __CMOS_HM1055_SENSOR__)
endif()

if(CONFIG_CMOS_GC0308_SENSOR)
    target_compile_definitions(app PRIVATE __CMOS_GC0308_SENSOR__)
endif()

if(${BOARD} STREQUAL "numaker_m55m1")
    target_compile_definitions(app PRIVATE __NUMAKER_M55M1__)
elseif(${BOARD} STREQUAL "numaker_gai_m55m1")
    target_compile_definitions(app PRIVATE __NUGESTUREAI_M55M1__)
    target_compile_definitions(app PRIVATE __WITHOUT_HYPERRAM__)
endif()

target_sources(app PRIVATE
    ${APP_SRC_DIR}/main.cpp
    ${APP_SRC_DIR}/BoardInit.cpp
    ${APP_SRC_DIR}/ModelFileReader.c
    ${APP_SRC_DIR}/ImgClassProcessing.cpp
)

target_sources(app PRIVATE
    ${APP_DEVICE_DIR}/HyperRAM/hyperram_code.c
    ${APP_DEVICE_DIR}/SDCard/sdglue.c
    ${APP_DEVICE_DIR}/SDCard/diskio_SDH.c
    ${APP_DEVICE_DIR}/ImageSensor/ImageSensor.c
    ${APP_DEVICE_DIR}/ImageSensor/Sensor/Sensor_HM1055.c
    ${APP_DEVICE_DIR}/ImageSensor/Sensor/Sensor_GC0308.c
    ${APP_DEVICE_DIR}/ImageSensor/Sensor/SWI2C.c
    ${APP_DEVICE_DIR}/UVC/UVC.c
    ${APP_DEVICE_DIR}/UVC/descriptors.c
    ${APP_DEVICE_DIR}/Display/Display.c
    ${APP_DEVICE_DIR}/Display/drv_pdma.c
    ${APP_DEVICE_DIR}/Display/Font8_16.c
    ${APP_DEVICE_DIR}/Display/LCD/LCD_LT7381.c
    ${APP_DEVICE_DIR}/Display/LCD/LCD_ILI9341.c
    ${APP_DEVICE_DIR}/Display/LCD/LCD_FSA506.c
)

target_sources(app PRIVATE
    ${APP_PROFILER_DIR}/pmu_counter.c
)

target_sources(app PRIVATE
    ${APP_NPU_DIR}/ethosu_profiler.c
)

target_sources(app PRIVATE
    ${APP_MODEL_DIR}/MobileNetModel.cpp
    ${APP_MODEL_DIR}/NN_Model_INT8.tflite.cpp
    ${APP_MODEL_DIR}/Labels.cpp
)

target_sources(app PRIVATE
    ${APP_THIRDPARTY_MLEVK_DIR}/source/application/api/common/source/Model.cpp
    ${APP_THIRDPARTY_MLEVK_DIR}/source/application/api/common/source/ImageUtils.cpp
    ${APP_THIRDPARTY_MLEVK_DIR}/source/application/api/common/source/TensorFlowLiteMicro.cpp
    ${APP_THIRDPARTY_MLEVK_DIR}/source/application/api/common/source/Classifier.cpp
    ${APP_THIRDPARTY_MLEVK_DIR}/source/math/PlatformMath.cpp
    ${APP_THIRDPARTY_MLEVK_DIR}/source/profiler/Profiler.cpp
)

target_sources(app PRIVATE
    ${ZEPHYR_NUVOTON_MODULE_DIR}/m55m1x/StdDriver/src/spim_hyper.c
    ${ZEPHYR_NUVOTON_MODULE_DIR}/m55m1x/StdDriver/src/sdh.c
    ${ZEPHYR_NUVOTON_MODULE_DIR}/m55m1x/StdDriver/src/ccap.c
    ${ZEPHYR_NUVOTON_MODULE_DIR}/m55m1x/StdDriver/src/hsusbd.c
    ${ZEPHYR_NUVOTON_MODULE_DIR}/m55m1x/StdDriver/src/ebi.c
    ${ZEPHYR_NUVOTON_MODULE_DIR}/m55m1x/StdDriver/src/pdma.c
    ${ZEPHYR_NUVOTON_MODULE_DIR}/m55m1x/StdDriver/src/spi.c
)

target_sources(app PRIVATE
    ${ZEPHYR_FATFS_MODULE_DIR}/ff.c
    ${ZEPHYR_FATFS_MODULE_DIR}/option/ffunicode.c
)

target_link_libraries(app PRIVATE 
    ${PROJECT_SOURCE_DIR}/${APP_THIRDPARTY_OMV}/omv/Lib/libomv.a
)

# Add platform specific linker source snippet
zephyr_linker_sources(SECTIONS sram_non-cache_section.ld)
```

## prj.conf
```kconfig
#application default configuration
CONFIG_CPP=y
CONFIG_STD_CPP17=y
# Include TFLM based on CMSIS NN optimization and ETHOSU acceleration
CONFIG_TENSORFLOW_LITE_MICRO=y
CONFIG_TENSORFLOW_LITE_MICRO_CMSIS_NN_KERNELS=y
# Enable Ethos-U support
CONFIG_ETHOS_U=y
# Disable Ethos-U D-Cache flush/invalidate operations 
CONFIG_ETHOS_U_DCACHE=n
# Set main stack size to 8 KB
CONFIG_MAIN_STACK_SIZE=8192
# Set heap memory pool size to 64 KB
CONFIG_HEAP_MEM_POOL_SIZE=65536
# Enable Floating Point Unit (FPU) support
CONFIG_FPU=y
# Enable logging subsystem
CONFIG_LOG=y
# Enable log processing thread custom priority
CONFIG_LOG_PROCESS_THREAD_CUSTOM_PRIORITY=y
# Set log processing thread priority to 2
CONFIG_LOG_PROCESS_THREAD_PRIORITY=2
# Set log buffer size to 8 KB
CONFIG_LOG_BUFFER_SIZE=8192
# Disable log backend showing level
CONFIG_LOG_BACKEND_SHOW_LEVEL=n
# Enable floating point support in printf
CONFIG_REQUIRES_FLOAT_PRINTF=y
# Set system tick frequency to 1000 Hz
CONFIG_SYS_CLOCK_TICKS_PER_SEC=1000
# Enable compiler optimizations for vectorization
CONFIG_COMPILER_OPT="-ftree-vectorize"
# Enable I/D cache
CONFIG_CACHE_MANAGEMENT=y

# NN_ImgClassInference application specific configurations
# Enable application profiling 
CONFIG_APP_OD_PROFILE_ENABLED=n
# Show result image over UVC
CONFIG_APP_OD_UVC_SHOW_IMAGE=n
# Show result image over LCD
CONFIG_APP_OD_LCD_SHOW_IMAGE=n
# Enable GC0308 image sensor for NuGestureAI-M55M1 board
CONFIG_CMOS_GC0308_SENSOR=y
```

## src/BoardInit.cpp
```c
/**************************************************************************//**
 * @file     BoardInit.cpp
 * @version  V1.00
 * @brief    Target board initiate function
 *
 * @copyright SPDX-License-Identifier: Apache-2.0
 * @copyright Copyright (C) 2023 Nuvoton Technology Corp. All rights reserved.
 ******************************************************************************/
#include <cstdio>

#include "NuMicro.h"
#include "hyperram_code.h"

#define DESIGN_NAME "M55M1"
#define HYPERRAM_SPIM_PORT SPIM0        //For NuMaker-M55M1 board

static void SDCard0_PinConfig(void)
{
	/* Set multi-function pin for SDH */
    SET_SD0_nCD_PD13();
    SET_SD0_CLK_PE6();
    SET_SD0_CMD_PE7();
    SET_SD0_DAT0_PE2();
    SET_SD0_DAT1_PE3();
    SET_SD0_DAT2_PE4();
    SET_SD0_DAT3_PE5();
}

static void SDCard1_PinConfig(void)
{
	/* Set multi-function pin for SDH */
    SET_SD1_nCD_PA6();
    SET_SD1_CLK_PB6();
    SET_SD1_CMD_PA5();
    SET_SD1_DAT0_PA8();
    SET_SD1_DAT1_PA9();
    SET_SD1_DAT2_PA10();
    SET_SD1_DAT3_PA11();
}

static void SYS_Init(void)
{
    /* Enable APLL1 clock */
    CLK_EnableAPLL(CLK_APLLCTL_APLLSRC_HXT, FREQ_220MHZ, CLK_APLL1_SELECT);

   /* Update System Core Clock */
    /* User can use SystemCoreClockUpdate() to calculate SystemCoreClock. */
    SystemCoreClockUpdate();

    /* Enable GPIO module clock */
    CLK_EnableModuleClock(GPIOA_MODULE);
    CLK_EnableModuleClock(GPIOB_MODULE);
    CLK_EnableModuleClock(GPIOC_MODULE);
    CLK_EnableModuleClock(GPIOD_MODULE);
    CLK_EnableModuleClock(GPIOE_MODULE);
    CLK_EnableModuleClock(GPIOF_MODULE);
    CLK_EnableModuleClock(GPIOG_MODULE);
    CLK_EnableModuleClock(GPIOH_MODULE);
    CLK_EnableModuleClock(GPIOI_MODULE);
    CLK_EnableModuleClock(GPIOJ_MODULE);

    /* Enable FMC0 module clock to keep FMC clock when CPU idle but NPU running*/
    CLK_EnableModuleClock(FMC0_MODULE);

    /* Enable NPU module clock */
    CLK_EnableModuleClock(NPU0_MODULE);

#if defined(__NUMAKER_M55M1__)
/* Enable SDH0 module clock source as HCLK and SDH0 module clock divider as 4 */
    CLK_SetModuleClock(SDH0_MODULE, CLK_SDHSEL_SDH0SEL_APLL1_DIV2, CLK_SDHDIV_SDH0DIV(5));
    CLK_EnableModuleClock(SDH0_MODULE);
#endif

#if defined(__NUGESTUREAI_M55M1__)
/* Enable SDH1 module clock source as HCLK and SDH1 module clock divider as 4 */
    CLK_SetModuleClock(SDH1_MODULE, CLK_SDHSEL_SDH1SEL_APLL1_DIV2, CLK_SDHDIV_SDH1DIV(5));
    CLK_EnableModuleClock(SDH1_MODULE);
#endif

    /* Enable CCAP0 module clock */
    CLK_EnableModuleClock(CCAP0_MODULE);

#if !defined(__WITHOUT_HYPERRAM__)
    HyperRAM_PinConfig(HYPERRAM_SPIM_PORT);
#endif

#if defined(__NUMAKER_M55M1__)
    SDCard0_PinConfig();
#endif
#if defined(__NUGESTUREAI_M55M1__)
    SDCard1_PinConfig();
#endif
}

/**
  * @brief Initiate the hardware resources of board
  * @return 0: Success, <0: Fail
  * @details Initiate clock, UART, NPU, hyperflash/hyperRAM
  * \hideinitializer
  */
int BoardInit(void)
{
    /* Unlock protected registers */
    SYS_UnlockReg();

    SYS_Init();
    SYS_LockReg();                   /* Unlock register lock protect */

#if !defined(__WITHOUT_HYPERRAM__)
    HyperRAM_Init(HYPERRAM_SPIM_PORT);
    /* Enter direct-mapped mode to run new applications */
    SPIM_HYPER_EnterDirectMapMode(HYPERRAM_SPIM_PORT);
#endif

    /* SDH open SD card*/
#if defined(__NUMAKER_M55M1__)
    SDH_Open_Disk(SDH0, CardDetect_From_GPIO);
#endif

#if defined(__NUGESTUREAI_M55M1__)
    SDH_Open_Disk(SDH1, CardDetect_From_GPIO);
#endif

    printf("%s: complete\n", __FUNCTION__);

    /* Print target design info */
    printf("Target system: %s\n", DESIGN_NAME);

    return 0;
}
```
