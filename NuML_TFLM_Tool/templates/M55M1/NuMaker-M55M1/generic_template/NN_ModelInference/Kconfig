## NuML_TFLM_Tool/templates/M55M1/NuMaker-M55M1/generic_template/NN_ModelInference/Kconfig
```kconfig
menu "NN_ModelInference Application Configurations"

config APP_OD_PROFILE_ENABLED
    bool "Application profiling enable"
    default n

endmenu
source "Kconfig.zephyr"
```
